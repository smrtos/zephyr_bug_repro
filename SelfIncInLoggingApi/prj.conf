## prj.conf
```kconfig
CONFIG_LOG=y
#CONFIG_LOG_MODE_DEFERRED=y
CONFIG_LOG_RUNTIME_FILTERING=y
CONFIG_LOG_BUFFER_SIZE=65536
CONFIG_LOG_PRINTK=y
CONFIG_LOG_PROCESS_TRIGGER_THRESHOLD=0
CONFIG_COVERAGE=n
CONFIG_LOG2_MODE_IMMEDIATE=y
CONFIG_LOG2_MODE_DEFERRED=n
#CONFIG_LOG_IMMEDIATE=y # not configurable by user
```

## src/main.c
```c
#include <zephyr.h>
#include <logging/log.h>
#include <kernel.h>


LOG_MODULE_REGISTER(main);


void main(void)
{
    LOG_INF("hello, main()\n");
    volatile int32_t ii = 0;


    while (ii < 100)
    {
        // bad one
        LOG_INF("hello, logger %d\n", ii++);

        // good one
        //LOG_INF("hello, logger %d\n", ii);
        //ii++;
    }

}
```
